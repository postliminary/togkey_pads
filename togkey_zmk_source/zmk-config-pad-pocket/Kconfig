## togkey_zmk_source/zmk-config-pad-pocket/Kconfig
```kconfig
menuconfig PAD_POCKET_BLE_BROADCAST
    bool "Pad Pocket two-host BLE broadcast behavior"
    default y
    depends on ZMK_BLE
    help
      Adds a behavior which sends one of the two monitor-control hotkeys to
      connected BLE profiles 0 and 1 without changing the active profile.
```

## togkey_zmk_source/zmk-config-pad-pocket/dts/bindings/behaviors/togkey,behavior-ble-broadcast.yaml
```yaml
description: Send a monitor-control hotkey to BLE profiles 0 and 1

compatible: "togkey,behavior-ble-broadcast"

include: one_param.yaml
```
